/**************************************************************************

Adicionar

POWER ON/OFF
AUTO POWER OFF
Aviso de bateria fraca
Indicação do ZERO
Indicação de HOLD
RANGE 0-90° E 0-180°

 **************************************************************************/

#include <SPI.h>
#include <Wire.h>
#include <Adafruit_GFX.h>
#include <Adafruit_SSD1306.h>

#define SCREEN_WIDTH 128 // OLED display width, in pixels
#define SCREEN_HEIGHT 64 // OLED display height, in pixels

// Declaration for an SSD1306 display connected to I2C (SDA, SCL pins)
// The pins for I2C are defined by the Wire-library. 
// On an arduino UNO:       A4(SDA), A5(SCL)
// On an arduino MEGA 2560: 20(SDA), 21(SCL)
// On an arduino LEONARDO:   2(SDA),  3(SCL), ...
#define OLED_RESET     4 // Reset pin # (or -1 if sharing Arduino reset pin)
#define SCREEN_ADDRESS 0x3C ///< See datasheet for Address; 0x3D for 128x64, 0x3C for 128x32

Adafruit_SSD1306 display(SCREEN_WIDTH, SCREEN_HEIGHT, &Wire, OLED_RESET);

#define LOGO_HEIGHT   64
#define LOGO_WIDTH    128
#define M_POS_X       22
#define M_POS_Y       36

// 'angulo180', 25x14px
const unsigned char bitmap_angulo180 [] PROGMEM = {
  0x00, 0x1c, 0x00, 0x00, 0x00, 0xdd, 0x80, 0x00, 0x03, 0xdd, 0xe0, 0x00, 0x07, 0x1c, 0x70, 0x00, 
  0x0e, 0x1c, 0x38, 0x00, 0x1c, 0x1c, 0x1c, 0x00, 0x38, 0x1c, 0x0e, 0x00, 0x30, 0x1c, 0x06, 0x00, 
  0x60, 0x1c, 0x03, 0x00, 0x60, 0x1c, 0x03, 0x00, 0x60, 0x1c, 0x03, 0x00, 0x00, 0x1c, 0x00, 0x00, 
  0xff, 0xff, 0xff, 0x80, 0xff, 0xff, 0xff, 0x80
};
// 'angulo90', 13x14px
const unsigned char bitmap_angulo90 [] PROGMEM = {
  0xc0, 0x00, 0xd8, 0x00, 0xde, 0x00, 0xc7, 0x00, 0xc3, 0x80, 0xc1, 0xc0, 0xc0, 0xe0, 0xc0, 0x60, 
  0xc0, 0x30, 0xc0, 0x30, 0xc0, 0x30, 0xc0, 0x00, 0xff, 0xf8, 0xff, 0xf8
};

// 'battery_low', 31x14px
const unsigned char bitmap_battery_low [] PROGMEM = {
  0xff, 0xff, 0xff, 0xf8, 0xff, 0xff, 0xff, 0xf8, 0xc0, 0x00, 0x00, 0x18, 0xd8, 0x00, 0x00, 0x18, 
  0xdc, 0x00, 0x00, 0x1e, 0xdc, 0x00, 0x00, 0x1e, 0xdc, 0x00, 0x00, 0x1e, 0xde, 0x00, 0x00, 0x1e, 
  0xde, 0x00, 0x00, 0x1e, 0xde, 0x00, 0x00, 0x1e, 0xdf, 0x00, 0x00, 0x18, 0xc0, 0x00, 0x00, 0x18, 
  0xff, 0xff, 0xff, 0xf8, 0xff, 0xff, 0xff, 0xf8
};

// 'logos_senai_preto', 128x64px
const unsigned char logo_senai_preto [] PROGMEM = {
  0x00, 0x00, 0x00, 0x00, 0x00, 0x00, 0x00, 0x00, 0x00, 0x00, 0x00, 0x00, 0x00, 0x00, 0x00, 0x00, 
  0x00, 0x00, 0x00, 0x00, 0x00, 0x00, 0x00, 0x00, 0x00, 0x00, 0x00, 0x00, 0x00, 0x00, 0x00, 0x00, 
  0x00, 0x00, 0x00, 0x00, 0x00, 0x00, 0x00, 0x00, 0x00, 0x00, 0x00, 0x00, 0x00, 0x00, 0x00, 0x00, 
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  0x00, 0x00, 0x00, 0x00, 0x00, 0x00, 0x00, 0x00, 0x00, 0x00, 0x00, 0x00, 0x00, 0x00, 0x00, 0x00
};

//Entradas
int bt_zero = 2;
int bt_hold = 3;
const int bateria = A0;


//Variáveis globais
bool zeroRelativo = false;
bool hold = false;
int range = 90;

void setup() {
  Serial.begin(9600);

  pinMode(bt_zero, INPUT_PULLUP);
  pinMode(bt_hold, INPUT_PULLUP);
  pinMode(LED_BUILTIN, OUTPUT);

  // SSD1306_SWITCHCAPVCC = generate display voltage from 3.3V internally
  if(!display.begin(SSD1306_SWITCHCAPVCC, SCREEN_ADDRESS)) {
    Serial.println(F("SSD1306 allocation failed"));
    for(;;); // Don't proceed, loop forever
  }
  
  desenhaLogoSENAI();
  delay(1000);
}

void loop() {

  display.clearDisplay();
  
  if(digitalRead(bt_zero) == 0){
    if(zeroRelativo) zeroRelativo = false;
    else zeroRelativo = true;
    delay(200);
  }
  if(digitalRead(bt_hold) == 0){
    if(hold) hold = false;
    else hold = true;
    delay(200);
  }
  //if(range == 90) desenha_90();
  desenha_180();
  //if(hold) ligaFuncaoHold();
  ligaFuncaoHold();
  //if(zeroRelativo) ligaFuncaoZero();
  ligaFuncaoZero();
  
  mostraAngulo();
  desenhaBateriaBaixa();

  display.display();
  delay(100);
}

int nivelBateria(){
  int cargaBateria = 83;
  cargaBateria = analogRead(bateria);
  return map(cargaBateria, 0, 1023, 0, 100);
  //return cargaBateria;
}

void ligaFuncaoZero(){
  display.setTextSize(2);
  display.setTextColor(SSD1306_WHITE);
  display.setCursor(40,0);
  //display.print("Z");
  display.write('Z');
}

void ligaFuncaoHold(){
  display.setTextSize(2);
  display.setTextColor(SSD1306_WHITE);
  display.setCursor(60,0);
  display.print("H");
}

float leAngulo(){
  float angulo = 45;
  return angulo;
}

void mostraAngulo(){
  display.setTextSize(4);
  display.setTextColor(SSD1306_WHITE);
  display.setCursor(M_POS_X,M_POS_Y);
  display.print(String(leAngulo(),1));
  display.drawCircle(M_POS_X + 100, M_POS_Y + 3, 3, SSD1306_WHITE);
}

void desenha_90(){
  display.drawBitmap(80, 0, bitmap_angulo90, 13, 14, 1);
}

void desenha_180(){
  display.drawBitmap(80, 0, bitmap_angulo180, 25, 14, 1);
}

// 'battery_low', 31x14px
//const unsigned char bitmap_battery_low [] PROGMEM = {
void desenhaBateriaBaixa(){
  display.drawBitmap(0, 0, bitmap_battery_low, 31, 14, 1);
}

void testdrawstyles(void) {
  display.clearDisplay();

  display.setTextSize(1);             // Normal 1:1 pixel scale
  display.setTextColor(SSD1306_WHITE);        // Draw white text
  display.setCursor(0,0);             // Start at top-left corner
  display.println(F("Hello, world!"));

  display.setTextColor(SSD1306_BLACK, SSD1306_WHITE); // Draw 'inverse' text
  display.println(3.141592);

  display.setTextSize(2);             // Draw 2X-scale text
  display.setTextColor(SSD1306_WHITE);
  display.print(F("0x")); display.println(0xDEADBEEF, HEX);

  display.display();
  delay(2000);
}

void testscrolltext(void) {
  display.clearDisplay();

  display.setTextSize(2); // Draw 2X-scale text
  display.setTextColor(SSD1306_WHITE);
  display.setCursor(10, 0);
  display.println(F("scroll"));
  display.display();      // Show initial text
  delay(100);

  // Scroll in various directions, pausing in-between:
  display.startscrollright(0x00, 0x0F);
  delay(2000);
  display.stopscroll();
  delay(1000);
  display.startscrollleft(0x00, 0x0F);
  delay(2000);
  display.stopscroll();
  delay(1000);
  display.startscrolldiagright(0x00, 0x07);
  delay(2000);
  display.startscrolldiagleft(0x00, 0x07);
  delay(2000);
  display.stopscroll();
  delay(1000);
}

void desenhaLogoSENAI(void) {
  display.clearDisplay();
  display.drawBitmap(
    (display.width()  - LOGO_WIDTH ) / 2,
    (display.height() - LOGO_HEIGHT) / 2,
    logo_senai_preto, LOGO_WIDTH, LOGO_HEIGHT, 1);
  display.display();
}
