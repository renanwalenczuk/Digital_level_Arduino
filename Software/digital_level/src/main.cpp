#include <Arduino.h>

//Bibliotecas
#include <Wire.h>             // Biblioteca para comunicação I2C
#include <Adafruit_GFX.h>     // Biblioteca elementos gráficos
#include <Adafruit_SSD1306.h> // Biblioteca Display
#include <SparkFun_ADXL345.h> // Biblioteca acelerômetro

//Definições do display
#define SCREEN_WIDTH 128    // Especifica a largura do display em pixels
#define SCREEN_HEIGHT 64    // Especifica a altura do display em pixels
#define OLED_RESET     -1   // pino de reset do display # (-1 se for utilizar o reset do arduino)
#define SCREEN_ADDRESS 0x3C // Endereço de comunicação do display (vide datasheet)

Adafruit_SSD1306 display(SCREEN_WIDTH, SCREEN_HEIGHT, &Wire, OLED_RESET); //Instancia o objeto display de acordo com as especificações indicadas

//Definições do Acelerômetro
//ADXL345 adxl = ADXL345(10); //Instancia o objeto adxl(acelerometro) comunicação SPI
ADXL345 adxl = ADXL345();     //Instancia o objeto adxl(acelerometro) comunicação I2C por padrão

//Constantes do usuário
#define LOGO_HEIGHT   64  //Altura do logotipo
#define LOGO_WIDTH    128 //largura do logotipo
#define M_POS_X       30  //Posição da medição eixo x
#define M_POS_Y       36  //Posição da medição eixo y

#define BATERIA_BAIXA 500  //Nível mínimo da bateria

// 'angulo180', 25x14px
const unsigned char bitmap_angulo180 [] PROGMEM = {
  0x00, 0x1c, 0x00, 0x00, 0x00, 0xdd, 0x80, 0x00, 0x03, 0xdd, 0xe0, 0x00, 0x07, 0x1c, 0x70, 0x00, 
  0x0e, 0x1c, 0x38, 0x00, 0x1c, 0x1c, 0x1c, 0x00, 0x38, 0x1c, 0x0e, 0x00, 0x30, 0x1c, 0x06, 0x00, 
  0x60, 0x1c, 0x03, 0x00, 0x60, 0x1c, 0x03, 0x00, 0x60, 0x1c, 0x03, 0x00, 0x00, 0x1c, 0x00, 0x00, 
  0xff, 0xff, 0xff, 0x80, 0xff, 0xff, 0xff, 0x80
};
// 'angulo90', 13x14px
const unsigned char bitmap_angulo90 [] PROGMEM = {
  0xc0, 0x00, 0xd8, 0x00, 0xde, 0x00, 0xc7, 0x00, 0xc3, 0x80, 0xc1, 0xc0, 0xc0, 0xe0, 0xc0, 0x60, 
  0xc0, 0x30, 0xc0, 0x30, 0xc0, 0x30, 0xc0, 0x00, 0xff, 0xf8, 0xff, 0xf8
};

// 'seta_para_cima', 13x7px
const unsigned char bitmap_seta_para_cima [] PROGMEM = {
	0x02, 0x00, 0x07, 0x00, 0x0f, 0x80, 0x1f, 0xc0, 0x3f, 0xe0, 0x7f, 0xf0, 0xff, 0xf8
};

// 'seta_para_baixo', 13x7px
const unsigned char bitmap_seta_para_baixo [] PROGMEM = {
	0xff, 0xf8, 0x7f, 0xf0, 0x3f, 0xe0, 0x1f, 0xc0, 0x0f, 0x80, 0x07, 0x00, 0x02, 0x00
};

// 'battery_baixa_pequeno', 24x14px
const unsigned char bitmap_battery_low [] PROGMEM = {
	0xff, 0xff, 0xfc, 0xff, 0xff, 0xfc, 0xc0, 0x00, 0x0c, 0xd8, 0x00, 0x0c, 0xdc, 0x00, 0x0f, 0xdc, 
	0x00, 0x0f, 0xdc, 0x00, 0x0f, 0xde, 0x00, 0x0f, 0xde, 0x00, 0x0f, 0xde, 0x00, 0x0f, 0xdf, 0x00, 
	0x0c, 0xc0, 0x00, 0x0c, 0xff, 0xff, 0xfc, 0xff, 0xff, 0xfc
};

// 'logos_senai_preto', 128x64px
const unsigned char logo_senai_preto [] PROGMEM = {
  0x00, 0x00, 0x00, 0x00, 0x00, 0x00, 0x00, 0x00, 0x00, 0x00, 0x00, 0x00, 0x00, 0x00, 0x00, 0x00, 
  0x00, 0x00, 0x00, 0x00, 0x00, 0x00, 0x00, 0x00, 0x00, 0x00, 0x00, 0x00, 0x00, 0x00, 0x00, 0x00, 
  0x00, 0x00, 0x00, 0x00, 0x00, 0x00, 0x00, 0x00, 0x00, 0x00, 0x00, 0x00, 0x00, 0x00, 0x00, 0x00, 
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  0x00, 0x00, 0x00, 0x00, 0x00, 0x00, 0x00, 0x00, 0x00, 0x00, 0x00, 0x00, 0x00, 0x00, 0x00, 0x00
};

//Entradas
int bt_zero = 5;
int bt_hold = 6;
int bt_range = 7;
const int pinoBateria = A0;

//Variáveis globais
bool zeroRelativo = false;
bool hold = false;
float angulo = 0, anguloRelativo = 0;
int x,y,z; //Medidas de aceleração da gravidade

//Funções do usuário
void leAcelerometro(){
  adxl.readAccel(&x, &y, &z);         // Realiza a leitura do acelerômetro e salva nas variáveis x,y e z
}

void configuraAcelerometro(){
  adxl.powerOn();                     // Power on the ADXL345

  adxl.setRangeSetting(8);           // Give the range settings
                                      // Accepted values are 2g, 4g, 8g or 16g
                                      // Higher Values = Wider Measurement Range
                                      // Lower Values = Greater Sensitivity

  adxl.setSpiBit(0);                  // Configure the device to be in 4 wire SPI mode when set to '0' or 3 wire SPI mode when set to 1
                                      // Default: Set to 1
                                      // SPI pins on the ATMega328: 11, 12 and 13 as reference in SPI Library 
   
  adxl.setActivityXYZ(1, 0, 0);       // Set to activate movement detection in the axes "adxl.setActivityXYZ(X, Y, Z);" (1 == ON, 0 == OFF)
  adxl.setActivityThreshold(75);      // 62.5mg per increment   // Set activity   // Inactivity thresholds (0-255)
 
  adxl.setInactivityXYZ(1, 0, 0);     // Set to detect inactivity in all the axes "adxl.setInactivityXYZ(X, Y, Z);" (1 == ON, 0 == OFF)
  adxl.setInactivityThreshold(75);    // 62.5mg per increment   // Set inactivity // Inactivity thresholds (0-255)
  adxl.setTimeInactivity(10);         // How many seconds of no activity is inactive?

  adxl.setTapDetectionOnXYZ(0, 0, 1); // Detect taps in the directions turned ON "adxl.setTapDetectionOnX(X, Y, Z);" (1 == ON, 0 == OFF)
 
  // Set values for what is considered a TAP and what is a DOUBLE TAP (0-255)
  adxl.setTapThreshold(50);           // 62.5 mg per increment
  adxl.setTapDuration(15);            // 625 μs per increment
  adxl.setDoubleTapLatency(80);       // 1.25 ms per increment
  adxl.setDoubleTapWindow(200);       // 1.25 ms per increment
 
  // Set values for what is considered FREE FALL (0-255)
  adxl.setFreeFallThreshold(7);       // (5 - 9) recommended - 62.5mg per increment
  adxl.setFreeFallDuration(30);       // (20 - 70) recommended - 5ms per increment
 
  // Setting all interupts to take place on INT1 pin
  //adxl.setImportantInterruptMapping(1, 1, 1, 1, 1);     // Sets "adxl.setEveryInterruptMapping(single tap, double tap, free fall, activity, inactivity);" 
                                                        // Accepts only 1 or 2 values for pins INT1 and INT2. This chooses the pin on the ADXL345 to use for Interrupts.
                                                        // This library may have a problem using INT2 pin. Default to INT1 pin.
  
  // Turn on Interrupts for each mode (1 == ON, 0 == OFF)
  adxl.InactivityINT(0);
  adxl.ActivityINT(0);
  adxl.FreeFallINT(0);
  adxl.doubleTapINT(0);
  adxl.singleTapINT(0);
}

int nivelBateria(){
  return analogRead(pinoBateria);
}

void desenhaZero(){
  display.setTextSize(2);
  display.setTextColor(SSD1306_WHITE);
  display.setCursor(40,0);
  display.print("Z");
}

void desenhaHold(){
  display.setTextSize(2);
  display.setTextColor(SSD1306_WHITE);
  display.setCursor(60,0);
  display.print("H");
}

int converteAngulo(){
  return ((atan2(x,y) * 180)/ 3.14)+90;;
}

void mostraAngulo(int angulo){
  display.setTextSize(4);
  display.setTextColor(SSD1306_WHITE);
  display.setCursor(M_POS_X,M_POS_Y);

  char texto[5];
  sprintf(texto,"%3i", angulo);
  display.print(texto);

  display.drawCircle(M_POS_X + 75, M_POS_Y + 3, 3, SSD1306_WHITE);
}

void desenha_90(){
  display.drawBitmap(80, 0, bitmap_angulo90, 13, 14, 1);
}

void desenha_180(){
  display.drawBitmap(80, 0, bitmap_angulo180, 25, 14, 1);
}

void desenhaBateriaBaixa(){
  display.drawBitmap(0, 0, bitmap_battery_low, 24, 14, 1);
}

void desenhaLogoSENAI(void) {
  display.clearDisplay();
  display.drawBitmap(
    (display.width()  - LOGO_WIDTH ) / 2,
    (display.height() - LOGO_HEIGHT) / 2,
    logo_senai_preto, LOGO_WIDTH, LOGO_HEIGHT, 1);
  display.display();
}

void desenhaSeta(){
  if(angulo < 0) display.drawBitmap(114, 0, bitmap_seta_para_cima, 13, 7, 1);
  else if(angulo > 0)display.drawBitmap(114, 0, bitmap_seta_para_baixo, 13, 7, 1);
}

void debug(void){
  Serial.print(x);
  Serial.print(", ");
  Serial.print(y);
  Serial.print(", ");
  Serial.println(z);
  float teste = (atan2(y,x) * 180)/ 3.14;
  Serial.println(teste);
  }

void setup() {
  Serial.begin(9600);
  
  pinMode(bt_zero, INPUT_PULLUP);
  pinMode(bt_hold, INPUT_PULLUP);
  pinMode(bt_range, INPUT_PULLUP);
  pinMode(LED_BUILTIN, OUTPUT);

  configuraAcelerometro();

  // SSD1306_SWITCHCAPVCC = generate display voltage from 3.3V internally
  /*
  if(!display.begin(SSD1306_SWITCHCAPVCC, SCREEN_ADDRESS)) {
    Serial.println(F("SSD1306 allocation failed"));
    for(;;); // Don't proceed, loop forever
  }*/

  display.begin(SSD1306_SWITCHCAPVCC, SCREEN_ADDRESS);
  
  desenhaLogoSENAI();
  delay(1000);
}

void atualizaDisplay(){
  if(angulo > 90) {
    angulo -= 180;
    display.setRotation(2);
  }
  else display.setRotation(0);

  desenha_90();
  if(hold) desenhaHold();
  if(zeroRelativo) desenhaZero();
  if(nivelBateria() < BATERIA_BAIXA) desenhaBateriaBaixa();
  desenhaSeta();
  mostraAngulo(abs(angulo));
  display.display();
}

void loop() {

  display.clearDisplay();

  leAcelerometro();

  if(!hold) angulo = converteAngulo() - anguloRelativo;

  atualizaDisplay();

  if(!digitalRead(bt_zero)){
    if(zeroRelativo){
      zeroRelativo = false;
      anguloRelativo = 0;
    }
    else{
      zeroRelativo = true;
      anguloRelativo = angulo;
    }
    delay(200);
  }

  if(!digitalRead(bt_hold)){
    if(hold) hold = false;
    else hold = true;
    delay(200);
  }

  delay(100);
}